## build/conf/bblayers.conf
```bitbake
POKY_BBLAYERS_CONF_VERSION = "2"

BBPATH = "${TOPDIR}"
BBFILES ?= ""

BBLAYERS ?= " \
  ${TOPDIR}/../openembedded-core/meta \
  ${TOPDIR}/../meta-yocto/meta-poky \
  ${TOPDIR}/../meta-yocto/meta-yocto-bsp \
  ${TOPDIR}/../meta-openembedded/meta-oe \
  ${TOPDIR}/../meta-openembedded/meta-python \
  ${TOPDIR}/../meta-openembedded/meta-networking \
  ${TOPDIR}/../meta-openembedded/meta-filesystems \
  ${TOPDIR}/../meta-virtualization \
  ${TOPDIR}/../meta-kabanos \
  "
```

## meta-kabanos/conf/distro/kabanos.conf
```bitbake
require conf/distro/poky.conf

DISTRO = "kabanos"
DISTRO_NAME = "a minimal podman container distro"
DISTRO_VERSION = "0.1"
MAINTAINER = "Gyokhan Kochmarla <kabanos@gyokhan.com>"

PACKAGE_CLASSES ?= "package_ipk"

DISTRO_FEATURES:append = " ipv6 virtualization "
DISTRO_FEATURES:remove = " wifi bluetooth sound 3g nfc modemmanager pulseaudio"
```

## meta-kabanos/conf/machine/kabanos-bbb.conf
```bitbake
require conf/machine/beaglebone-yocto.conf

PREFERRED_PROVIDER_virtual/kernel = "linux-amazon"
```

## meta-kabanos/recipes-core/images/kabanos.wks
```
part /boot --source bootimg-pcbios --ondisk sda --size 64M --fs-type=vfat --active --align 4
part / --source rootfs --ondisk sda --size 2G --fs-type=ext4

bootloader --ptable msdos --timeout=10 --append="root=/dev/sda2 rootwait rw console=ttyS0"
```
